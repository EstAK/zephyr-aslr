## boards/khadas/edge2/Kconfig.khadas_edge2
```kconfig
# Copyright 2024 TODO
# SPDX-License-Identifier: Apache-2.0

config BOARD_KHADAS_EDGE2
	select SOC_RK3588S
```

## soc/rockchip/rk3588s/Kconfig.defconfig.rk3588s
```kconfig
#
# Copyright 2024 TODO
#
# SPDX-License-Identifier: Apache-2.0
#

if SOC_RK3588S

config NUM_IRQS
	int
	default 240

config FLASH_SIZE
	default 0

config FLASH_BASE_ADDRESS
	default 0

endif
```

## soc/rockchip/rk3588s/Kconfig.soc
```kconfig
#
# Copyright 2024 TODO
#
# SPDX-License-Identifier: Apache-2.0
#

config SOC_RK3588S
	bool
	select SOC_SERIES_RK3588S

config SOC_SERIES_RK3588S
	bool
	select SOC_FAMILY_ROCKCHIP

config SOC
	default "rk3588s" if SOC_RK3588S

config SOC_SERIES
	default "rk3588s" if SOC_SERIES_RK3588S
```
